#include "rolio.dtsi"

&kscan0 {
    col-gpios
        = <&gpio0 2 GPIO_ACTIVE_HIGH>
        , <&gpio1 15 GPIO_ACTIVE_HIGH>
        , <&gpio1 13 GPIO_ACTIVE_HIGH>
        , <&gpio1 11 GPIO_ACTIVE_HIGH>
        , <&gpio0 10 GPIO_ACTIVE_HIGH>
        , <&gpio0 9 GPIO_ACTIVE_HIGH>
        ;
};

&encoder_left {
    status = "okay";
};

&pwm0 {
  status = "okay";
  pinctrl-0 = <&pwm0_default>;
  pinctrl-1 = <&pwm0_sleep>;
  pinctrl-names = "default", "sleep";
};

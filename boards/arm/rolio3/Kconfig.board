## boards/arm/rolio3/Kconfig.board
```kconfig
# nice!nano board configuration

# Copyright (c) 2020 Pete Johanson
# SPDX-License-Identifier: MIT

config BOARD_ROLIO3
    bool "Rolio Core V3"
    depends on SOC_NRF52840_QIAA
```

## config/west.yml
```yaml
manifest:
  remotes:
    - name: zmkfirmware
      url-base: https://github.com/zmkfirmware
    - name: tklzg
      url-base: https://github.com/tklzg
    - name: stephen
      url-base: https://github.com/stephen
    - name: elpekenin
      url-base: https://github.com/elpekenin
  projects:
    - name: zmk
      import: app/west.yml
      remote: zmkfirmware
      revision: main
    - name: zmk-userspace
      remote: elpekenin
      revision: main
  self:
    path: config
```
